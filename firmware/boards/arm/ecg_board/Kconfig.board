## firmware/boards/arm/ecg_board/Kconfig.board
```kconfig
# Copyright (c) 2023 Nordic Semiconductor ASA
# SPDX-License-Identifier: Apache-2.0

config BOARD_RENFORCE_ECG_BOARD
	bool "renforce-ecg-board"
	depends on SOC_NRF52840_QIAA
```

## firmware/boards/arm/ecg_board/Kconfig.defconfig
```kconfig
# Copyright (c) 2023 Nordic Semiconductor ASA
# SPDX-License-Identifier: Apache-2.0

if BOARD_RENFORCE_ECG_BOARD

config BOARD
	default "renforce_ecg_board"

config BT_CTLR
   default BT

endif
```
